## main/Kconfig.projbuild
```kconfig
menu "Monitor ESP Configuration"
config I2S_LRCK_PIN
    int "I2S LRCK (WS) GPIO"
    default 25
    help
        GPIO number to use for I2S LRCK(WS) Driver.

config I2S_BCK_PIN
    int "I2S BCK GPIO"
    default 27
    help
        GPIO number to use for I2S BCK Driver.

config I2S_DATA_PIN
    int "I2S DATA GPIO"
    default 26
    help
        GPIO number to use for I2S Data Driver.

endmenu
```
